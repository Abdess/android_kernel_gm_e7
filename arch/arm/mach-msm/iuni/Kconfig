## arch/arm/mach-msm/iuni/Kconfig
```kconfig
config GN_MACH_IUNI
	bool
	depends on ARCH_MSM

menu "Gionee board selection"

config GN_MACH_MSM8974_U810_SUPPORT
	bool "IUNI U2"
	select GN_MACH_GIONEE
	help
	  Support for the IUNI U2 (U810)

config GN_MACH_MSM8974_NBL8910A_SUPPORT
	bool "IUNI U3"
	select GN_MACH_GIONEE
	help
	  Support for the IUNI U3 (NBL8910A)

endmenu
```

## drivers/misc/gn/Kconfig
```kconfig
menu "Gionee specific support"

###################################################
# COMMON GIONEE'S KERNEL FLAGS ENABLED BY DEFAULT #
###################################################

config GN_Q_BSP_CHARGE_VOLTAGE_SUPPORT
	bool "GN_Q_BSP_CHARGE_VOLTAGE_SUPPORT"
	default y

config GN_Q_BSP_AUDIO_HEADSET_SUPPORT
	bool "GN_Q_BSP_AUDIO_HEADSET_SUPPORT"
	default y

config GN_CAMERA_SUPPORT
	bool "GN_CAMERA_SUPPORT"
	default y

config GN_Q_BSP_LCD_TE_ANALOG_SUPPORT
	bool "GN_Q_BSP_LCD_TE_ANALOG_SUPPORT"
	default y

config GN_Q_BSP_BACKLIGHT_LM3630_SUPPORT
	bool "GN_Q_BSP_BACKLIGHT_LM3630_SUPPORT"
	default y

config GN_Q_BSP_LCD_TPS65132_SUPPORT
	bool "GN_Q_BSP_LCD_TPS65132_SUPPORT"
	default y

config GN_Q_BSP_LCD_RESET_SUPPORT
	bool "GN_Q_BSP_LCD_RESET_SUPPORT"
	default y

config GN_Q_BSP_PMIC_DISABLE_LOW_TM_INTERRUPTS_SUPPORT
	bool "GN_Q_BSP_PMIC_DISABLE_LOW_TM_INTERRUPTS_SUPPORT"
	default y

config GN_Q_BSP_BATTERY_10K_NTC_SUPPORT
	bool "GN_Q_BSP_BATTERY_10K_NTC_SUPPORT"
	default y

config GN_Q_BSP_PM_NON_STANDARD_CHARGER_SUPPORT
	bool "GN_Q_BSP_PM_NON_STANDARD_CHARGER_SUPPORT"
	default y

config GN_Q_BSP_ISA1200_QPNPCLK_SUPPORT
	bool "GN_Q_BSP_ISA1200_QPNPCLK_SUPPORT"
	default y

config GN_Q_BSP_ISA1200_LEVEL_SUPPORT
	bool "GN_Q_BSP_ISA1200_LEVEL_SUPPORT"
	default y

config GN_Q_BSP_OPTIMIZE_SOC_SUPPORT
	bool "GN_Q_BSP_OPTIMIZE_SOC_SUPPORT"
	default y

config GN_Q_BSP_BTC_CONFIG_SUPPORT
	bool "GN_Q_BSP_BTC_CONFIG_SUPPORT"
	default y

config GN_Q_BSP_OVP_9P5V_SUPPORT
	bool "GN_Q_BSP_OVP_9P5V_SUPPORT"
	default y

config GN_Q_BSP_PM8941_CHARGER_SUPPORT
	bool "GN_Q_BSP_PM8941_CHARGER_SUPPORT"
	default y

config GN_Q_BSP_PM_CHG_DEBUG_SUPPORT
	bool "GN_Q_BSP_PM_CHG_DEBUG_SUPPORT"
	default y

config GN_Q_BSP_LK_DISABLE_EMMC_HS400
	bool "GN_Q_BSP_LK_DISABLE_EMMC_HS400"
	default y

config GN_Q_BSP_ENFORCE_EMMC_TIMEOUT_SUPPORT
	bool "GN_Q_BSP_ENFORCE_EMMC_TIMEOUT_SUPPORT"
	default y

#####################
# U3'S KERNEL FLAGS #
#####################

config GN_MACH_IUNI
	bool "GN_MACH_IUNI"

config GN_MACH_MSM8974_NBL8910A_SUPPORT
	bool "GN_MACH_MSM8974_NBL8910A_SUPPORT"

config GN_MACH_MSM8974_NBL8910A_CAMERA_SUPPORT
	bool "GN_MACH_MSM8974_NBL8910A_CAMERA_SUPPORT"

config GN_Q_BSP_LCD_IOVCC_CONTROL_SUPPORT
	bool "GN_Q_BSP_LCD_IOVCC_CONTROL_SUPPORT"

config GN_Q_BSP_AUDIO_MBHC_CALIBRATION 
	bool "GN_Q_BSP_AUDIO_MBHC_CALIBRATION"

config GN_Q_BSP_PM_BMS_LOG_SUPPORT
	bool "GN_Q_BSP_PM_BMS_LOG_SUPPORT"

#####################
# U2'S KERNEL FLAGS #
#####################

config GN_MACH_IUNI
	bool "GN_MACH_IUNI"

config GN_MACH_MSM8974_U800_SUPPORT
	bool "GN_MACH_MSM8974_U800_SUPPORT"

config GN_U800_TORCH_SUPPORT
	bool "GN_U800_TORCH_SUPPORT"

config GN_U800_CAMERA_SUPPORT
	bool "GN_U800_CAMERA_SUPPORT"
	
config GN_Q_BSP_CPU_WR_HOTPLUG_DISABLED_SUPPORT
	bool "GN_Q_BSP_CPU_WR_HOTPLUG_DISABLED_SUPPORT"

config GN_CAMERA_24M_MCLOCK_SUPPORT
	bool "GN_CAMERA_24M_MCLOCK_SUPPORT"

config GN_Q_BSP_LCD_COMPATIBILITY_SUPPORT
	bool "GN_Q_BSP_LCD_COMPATIBILITY_SUPPORT"

config CONFIG_GN_Q_BSP_U810_LCD_TPS65132_SUPPORT
	bool "CONFIG_GN_Q_BSP_U810_LCD_TPS65132_SUPPORT"

config GN_SUNNY_OV16825
	bool "GN_SUNNY_OV16825"

config GN_SUNNY_OV4688
	bool "GN_SUNNY_OV4688"

config GN_Q_BSP_SUPPORT
	bool "GN_Q_BSP_SUPPORT"

config GN_Q_BSP_DEVICE_TYPE_CHECK_SUPPORT
	bool "GN_Q_BSP_DEVICE_TYPE_CHECK_SUPPORT"

endmenu
```
